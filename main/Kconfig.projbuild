## main/Kconfig.projbuild
```kconfig
menu "Weight Sensor Configuration"

    config WEIGHT_PD_SCK_GPIO
        int "PD/SCK GPIO number"
        default 4 if IDF_TARGET_ESP8266
        default 4 if IDF_TARGET_ESP32C2 || IDF_TARGET_ESP32C3 || IDF_TARGET_ESP32C5 || IDF_TARGET_ESP32C6 || IDF_TARGET_ESP32C61
        default 4 if IDF_TARGET_ESP32H2
        default 4 if IDF_TARGET_ESP32P4
        default 26 if IDF_TARGET_ESP32 || IDF_TARGET_ESP32S2 || IDF_TARGET_ESP32S3
        help
            GPIO number connected to PD/SCK pin

    config weight_dt_gpio
        int "DOUT GPIO number"
        default 5 if IDF_TARGET_ESP8266 || IDF_TARGET_ESP32C3
        default 5 if IDF_TARGET_ESP32C2 || IDF_TARGET_ESP32C3 || IDF_TARGET_ESP32C5 || IDF_TARGET_ESP32C6 || IDF_TARGET_ESP32C61
        default 5 if IDF_TARGET_ESP32H2
        default 5 if IDF_TARGET_ESP32P4
        default 32 if IDF_TARGET_ESP32 || IDF_TARGET_ESP32S2 || IDF_TARGET_ESP32S3
        help
            GPIO number connected to DOUT pin

    config WEIGHT_SAMPLE_TIMES
        int "Samples to average"
        default 10

    config WEIGHT_TARE
        int "Tare weight"
        default 0
        help
            Tare weight to subtract from the measured weight. This can be used to zero out the scale when there is a container on it.

    config WEIGHT_SCALE
        hex "Weight scale"
        default 0x100
        help
            Scale factor to convert raw sensor readings to actual weight.

    config WEIGHT_GAIN
        int "HX711 Gain"
        default 128
        help
            Gain factor for the HX711. Common values are 128, 64, and 32.

    config ESP_WIFI_HOSTNAME
        string "WiFi Hostname"
        default "weight-sensor"
        help
            Hostname for the device on the network.

    config ESP_WIFI_AP_SSID_PREFIX
        string "WiFi AP SSID Prefix"
        default "Sensor"
        help
            SSID (network name) prefix of the AP for the example to connect to.

    config ESP_WIFI_AP_CHANNEL
        int "WiFi AP Channel"
        range 1 14
        default 1
        help
            WiFi channel (network channel) of the AP for the example to use. 

    config ESP_WIFI_CONNECT_TIMEOUT_MS
        int "WiFi STA connect timeout (ms)"
        default 10000
        help
            Time (in milliseconds) to wait for the station to connect to the AP before timing out.
    
    config ESP_WIFI_AP_FALLBACK_DISABLE
        bool "Disable WiFi AP fallback"
        default n
        help
            If enabled, the device will not create a WiFi access point when it fails to connect to the configured station.
    
    config ESP_MAX_STA_CONN_AP
        int "Maximal STA connections"
        default 4
        help
            Max number of the STA connects to AP.      
                         
    config ESP_WIFI_SSID
        string "WiFi SSID"
        default ""
        help
            SSID (network name) for the example to connect to.

    config ESP_WIFI_PASSWORD
        string "WiFi Password"
        default ""
        help
            WiFi password (WPA or WPA2) for the example to use.

    choice ESP_WIFI_SAE_MODE
        prompt "WPA3 SAE mode selection"
        default ESP_WPA3_SAE_PWE_BOTH
        help
            Select mode for SAE as Hunt and Peck, H2E or both.
        config ESP_WPA3_SAE_PWE_HUNT_AND_PECK
            bool "HUNT AND PECK"
        config ESP_WPA3_SAE_PWE_HASH_TO_ELEMENT
            bool "H2E"
        config ESP_WPA3_SAE_PWE_BOTH
            bool "BOTH"
    endchoice

    config ESP_WIFI_PW_ID
        string "PASSWORD IDENTIFIER"
        depends on  ESP_WPA3_SAE_PWE_HASH_TO_ELEMENT|| ESP_WPA3_SAE_PWE_BOTH
        default ""
        help
            password identifier for SAE H2E

    config ESP_MAXIMUM_RETRY
        int "Maximum retry"
        default 5
        help
            Set the Maximum retry to avoid station reconnecting to the AP unlimited when the AP is really inexistent.

    choice ESP_WIFI_SCAN_AUTH_MODE_THRESHOLD
        prompt "WiFi Scan auth mode threshold"
        default ESP_WIFI_AUTH_WPA2_PSK
        help
            The weakest authmode to accept in the scan mode.
            This value defaults to ESP_WIFI_AUTH_WPA2_PSK incase password is present and ESP_WIFI_AUTH_OPEN is used.
            Please select ESP_WIFI_AUTH_WEP/ESP_WIFI_AUTH_WPA_PSK incase AP is operating in WEP/WPA mode.

        config ESP_WIFI_AUTH_OPEN
            bool "OPEN"
        config ESP_WIFI_AUTH_WEP
            bool "WEP"
        config ESP_WIFI_AUTH_WPA_PSK
            bool "WPA PSK"
        config ESP_WIFI_AUTH_WPA2_PSK
            bool "WPA2 PSK"
        config ESP_WIFI_AUTH_WPA_WPA2_PSK
            bool "WPA/WPA2 PSK"
        config ESP_WIFI_AUTH_WPA3_PSK
            bool "WPA3 PSK"
        config ESP_WIFI_AUTH_WPA2_WPA3_PSK
            bool "WPA2/WPA3 PSK"
        config ESP_WIFI_AUTH_WAPI_PSK
            bool "WAPI PSK"
    endchoice


    config OTA_FIRMWARE_UPGRADE_URL
        string "firmware upgrade url endpoint"
        default "https://ota.home.codybaker.net/weight.bin"
        help
            URL of server which hosts the firmware
            image.

    config HTTPD_BASIC_AUTH_USERNAME
        string "Basic Authenticate User Name"
        default "admin"
        help
            The client's user name which used for basic authenticate.

    config HTTPD_BASIC_AUTH_PASSWORD
        string "Basic Authenticate Password"
        default "admin"
        help
            The client's password which used for basic authenticate.
    
    config PUMP_DEFAULT_DISPENSE_ML
        int "Default pump dispense amount (ml)"
        default 8
        help
            Default amount of liquid to dispense in milliliters when no amount is specified.
endmenu

menu "RCWL-9620 Ultrasonic Sensor Configuration"

    config ENABLE_RCWL9620
        bool "Enable RCWL-9620 ultrasonic distance sensor support"
        default y
        help
            Enables support for the RCWL-9620 ultrasonic distance sensor (e.g. M5Stack Unit
            Sonic-IO). Disable to exclude this sensor entirely from the build. The sensor is
            also disabled at runtime by default until trigger/echo GPIO pins are configured
            in Settings.

    config RCWL9620_MAX_DISTANCE_CM
        int "Maximum measurable distance (cm)"
        default 450
        depends on ENABLE_RCWL9620
        help
            Maximum distance in centimeters to wait for an echo response. The RCWL-9620 is
            rated for a range of 2cm-450cm.
endmenu

menu "A02YYUW Ultrasonic Sensor Configuration"

    config ENABLE_A02YYUW
        bool "Enable A02YYUW waterproof ultrasonic distance sensor support"
        default y
        help
            Enables support for the DFRobot A02YYUW (SEN0311) waterproof UART ultrasonic
            distance sensor. Disable to exclude this sensor entirely from the build. The
            sensor is also disabled at runtime by default until its RX GPIO pin is
            configured in Settings.
endmenu

menu "Atlas Scientific EZO pH Sensor Configuration"

    config ENABLE_EZO_PH
        bool "Enable Atlas Scientific EZO pH sensor support"
        default y
        help
            Enables support for the Atlas Scientific EZO pH circuit over I2C. Disable to
            exclude this sensor entirely from the build. The sensor is also disabled at
            runtime by default until the shared I2C bus (configured via the Pump I2C
            SCL/SDA GPIO settings) and its I2C address are configured in Settings.

    config EZO_PH_DEFAULT_I2C_ADDR
        hex "Default EZO pH I2C address"
        default 0x63
        depends on ENABLE_EZO_PH
        help
            Factory-default I2C address of the Atlas Scientific EZO pH circuit.
endmenu
```
